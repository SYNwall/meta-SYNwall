## conf/layer.conf
```bitbake
#
# Copyright (C)2022 Marco Cavallini - KOAN sas - <https://koansoftware.com>
#

# We have a conf and classes directory, add to BBPATH
BBPATH .= ":${LAYERDIR}"

# We have recipes-* directories, add to BBFILES
BBFILES += "${LAYERDIR}/recipes-*/*/*.bb \
            ${LAYERDIR}/recipes-*/*/*.bbappend"

BBFILE_COLLECTIONS += "meta-synwall"
BBFILE_PATTERN_meta-synwall = "^${LAYERDIR}/"
BBFILE_PRIORITY_meta-synwall = "9"

LAYERDEPENDS_meta-synwall = "core"
LAYERSERIES_COMPAT_meta-synwall = "dunfell kirkstone"
```
